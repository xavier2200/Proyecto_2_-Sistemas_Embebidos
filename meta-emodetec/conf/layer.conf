## meta-emodetec/conf/layer.conf
```bitbake
# Añade el directorio de la capa al BBPATH
BBPATH .= ":${LAYERDIR}"

# Define las ubicaciones de las recetas
BBFILES += "${LAYERDIR}/recipes-*/*/*.bb \
            ${LAYERDIR}/recipes-*/*/*.bbappend"

# Identificador único de la capa
BBFILE_COLLECTIONS += "emodetec"

# Patrón para encontrar recetas en esta capa
BBFILE_PATTERN_emodetec := "^${LAYERDIR}/"

# Prioridad de la capa (ajusta según necesidad)
BBFILE_PRIORITY_emodetec = "6"

# Compatibilidad con versiones de Yocto
LAYERSERIES_COMPAT_emodetec = "kirkstone"
```
